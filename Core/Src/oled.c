#include "oled.h"
#include <stdarg.h>

/* 6x8 字体 (ASCII 32~127) */
static const uint8_t Font6x8[][6] = {
    {0x00,0x00,0x00,0x00,0x00,0x00}, /* ' ' */
    {0x00,0x00,0x5F,0x00,0x00,0x00}, /* ! */
    {0x00,0x07,0x00,0x07,0x00,0x00}, /* " */
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    {0x08,0x08,0x2A,0x1C,0x08,0x00}, /* ~ */
};

extern I2C_HandleTypeDef hi2c1;

static void OLED_WriteCmd(uint8_t cmd)
{
    uint8_t buf[2] = {0x00, cmd};
    HAL_I2C_Master_Transmit(&hi2c1, OLED_ADDR << 1, buf, 2, 100);
}

static void OLED_WriteData(uint8_t dat)
{
    uint8_t buf[2] = {0x40, dat};
    HAL_I2C_Master_Transmit(&hi2c1, OLED_ADDR << 1, buf, 2, 100);
}

void OLED_Init(void)
{
    HAL_Delay(100);

    OLED_WriteCmd(0xAE);
    OLED_WriteCmd(0xD5); OLED_WriteCmd(0x80);
    OLED_WriteCmd(0xA8); OLED_WriteCmd(0x3F);
    OLED_WriteCmd(0xD3); OLED_WriteCmd(0x00);
    OLED_WriteCmd(0x40);
    OLED_WriteCmd(0x8D); OLED_WriteCmd(0x14);
    OLED_WriteCmd(0x20); OLED_WriteCmd(0x00);
    OLED_WriteCmd(0xA1);
    OLED_WriteCmd(0xC8);
    OLED_WriteCmd(0xDA); OLED_WriteCmd(0x12);
    OLED_WriteCmd(0x81); OLED_WriteCmd(0xCF);
    OLED_WriteCmd(0xD9); OLED_WriteCmd(0xF1);
    OLED_WriteCmd(0xDB); OLED_WriteCmd(0x40);
    OLED_WriteCmd(0xA4);
    OLED_WriteCmd(0xA6);
    OLED_WriteCmd(0xAF);

    OLED_Clear();
}

void OLED_Clear(void)
{
    for (uint8_t page = 0; page < 8; page++)
    {
        OLED_WriteCmd(0xB0 + page);
        OLED_WriteCmd(0x00);
        OLED_WriteCmd(0x10);
        for (uint8_t col = 0; col < 128; col++)
            OLED_WriteData(0x00);
    }
}

void OLED_ShowChar(uint8_t x, uint8_t y, char ch, uint8_t size)
{
    if (ch < ' ' || ch > '~') ch = ' ';
    uint8_t idx = ch - ' ';

    if (size == 16)
    {
        OLED_WriteCmd(0xB0 + y);
        OLED_WriteCmd(((x & 0xF0) >> 4) | 0x10);
        OLED_WriteCmd(x & 0x0F);
        for (uint8_t i = 0; i < 6; i++) OLED_WriteData(Font6x8[idx][i]);
        for (uint8_t i = 0; i < 2; i++) OLED_WriteData(0x00);
        OLED_WriteCmd(0xB0 + y + 1);
        OLED_WriteCmd(((x & 0xF0) >> 4) | 0x10);
        OLED_WriteCmd(x & 0x0F);
        for (uint8_t i = 0; i < 6; i++) OLED_WriteData(Font6x8[idx][i]);
        for (uint8_t i = 0; i < 2; i++) OLED_WriteData(0x00);
    }
    else
    {
        OLED_WriteCmd(0xB0 + y);
        OLED_WriteCmd(((x & 0xF0) >> 4) | 0x10);
        OLED_WriteCmd(x & 0x0F);
        for (uint8_t i = 0; i < 6; i++) OLED_WriteData(Font6x8[idx][i]);
    }
}

void OLED_ShowString(uint8_t x, uint8_t y, const char *str, uint8_t size)
{
    while (*str)
    {
        OLED_ShowChar(x, y, *str, size);
        x += (size == 16) ? 8 : 6;
        if (x + ((size == 16) ? 8 : 6) > 128) { x = 0; y += (size == 16) ? 2 : 1; }
        str++;
    }
}

void OLED_ShowNum(uint8_t x, uint8_t y, uint32_t num, uint8_t len, uint8_t size)
{
    char buf[12];
    snprintf(buf, sizeof(buf), "%*lu", len, (unsigned long)num);
    OLED_ShowString(x, y, buf, size);
}

void OLED_ShowFloat(uint8_t x, uint8_t y, float num, uint8_t intLen, uint8_t decLen, uint8_t size)
{
    char buf[16];
    snprintf(buf, sizeof(buf), "%*.*f", intLen + decLen + 1, decLen, num);
    OLED_ShowString(x, y, buf, size);
}

void OLED_Printf(uint8_t x, uint8_t y, uint8_t size, const char *fmt, ...)
{
    char buf[32];
    va_list args;
    va_start(args, fmt);
    vsnprintf(buf, sizeof(buf), fmt, args);
    va_end(args);
    OLED_ShowString(x, y, buf, size);
}
